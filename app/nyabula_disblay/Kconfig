## app/nyabula_disblay/Kconfig
```kconfig
#
# For a description of the syntax of this configuration file,
# see the file kconfig-language.txt in the NuttX tools repository.
#

menuconfig GRAPHICS_NYABULA_DISPLAY
	tristate "Nyabula Display LVGL Compatibility Layer"
	default n
	depends on GRAPHICS_LVGL
	---help---
		Enable the Nyabula Display LVGL compatibility layer for NuttX.
		This provides LCD and touchscreen drivers for LVGL applications.

if GRAPHICS_NYABULA_DISPLAY

config NYABULA_DISPLAY_PRIORITY
	int "nyabula_display task priority"
	default 100

config NYABULA_DISPLAY_STACKSIZE
	int "nyabula_display stack size"
	default 32768

config NYABULA_DISPLAY_BUFFER_SIZE
	int "LCD buffer size in bytes"
	default 1048576
	---help---
		Size of the LCD draw buffer in bytes. Default is 1MB.

config NYABULA_DISPLAY_LCD_DEVPATH0
	string "First LCD device path"
	default "/dev/lcd0"
	---help---
		The path to the first LCD device.

config NYABULA_DISPLAY_LCD_DEVPATH1
	string "Second LCD device path"
	default "/dev/lcd1"
	---help---
		The path to the second LCD device.

config NYABULA_DISPLAY_SCREEN_WIDTH
	int "Screen width in pixels"
	default 360
	---help---
		Width of each screen in pixels.

config NYABULA_DISPLAY_SCREEN_HEIGHT
	int "Screen height in pixels"
	default 360
	---help---
		Height of each screen in pixels.

endif # GRAPHICS_NYABULA_DISPLAY
```

## drivers/drivers/st77916/Kconfig
```kconfig
#
# For a description of the syntax of this configuration file,
# see the file kconfig-language.txt in the NuttX tools repository.
#

config LCD_ST77916
    bool "ST77916-family QSPI LCD driver"
    default n
    ---help---
        Enable the QSPI LCD driver shared by the ST77916 and GC9B72
        controllers.  Both ICs use the same DCS command set
        (0x2A/0x2B/0x2C/0x36/0x3A) and QSPI (MIPI DBI Type C) transfer
        protocol; only the
        initialization sequence and a few register details differ.

        The driver is compatible with any NuttX QSPI lower-half driver; the
        board init code obtains the QSPI handle and passes it in.

if LCD_ST77916

choice
    prompt "Controller chip"
    default LCD_ST77916_CHIP_TYPE_ST77916

config LCD_ST77916_CHIP_TYPE_ST77916
    bool "ST77916"
    ---help---
        Use the ST77916 controller.  This is the default.

config LCD_ST77916_CHIP_TYPE_GC9B72
    bool "GC9B72"
    ---help---
        Use the GC9B72 controller.  Shares the same DCS command set and
        QSPI (MIPI DBI Type C) protocol as ST77916; only the
        initialization sequence and a few register details differ.

endchoice

endif # LCD_ST77916
```
